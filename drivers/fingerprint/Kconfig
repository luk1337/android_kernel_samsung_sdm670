## drivers/fingerprint/Kconfig
```kconfig
# SPDX-License-Identifier: GPL-2.0-only

menuconfig SENSORS_FINGERPRINT
	bool "Fingerprint sensor devices"
	help
	  Say Y here to get a list of fingerprint sensor drivers.

if SENSORS_FINGERPRINT

config SENSORS_FINGERPRINT_SECURE
	bool "Fingerprint sensor is owned by the secure world"
	default y
	help
	  The sensor SPI bus is driven by a TrustZone application. The
	  kernel only handles power, reset and the data-ready interrupt.

config SENSORS_ET5XX
	tristate "ET5XX fingerprint sensor support"
	depends on SPI
	help
	  Say Y here to enable support for the Egistec ET5XX
	  fingerprint sensor.

endif # SENSORS_FINGERPRINT
```

## drivers/input/touchscreen/stm/fts1ba90a/Kconfig
```kconfig
# SPDX-License-Identifier: GPL-2.0-only

config TOUCHSCREEN_FTS1BA90A
	tristate "STMicroelectronics FTS1BA90A touchscreen"
	depends on I2C
	select INPUT_SEC_CMD
	help
	  Say Y here to enable support for the STMicroelectronics
	  FTS1BA90A FingerTipS touchscreen used on Samsung devices.

	  If unsure, say N.
```

## drivers/muic/Kconfig
```kconfig
#
# MUIC devices
#

comment "MUIC configs"

config USE_MUIC
	bool "Using MUIC device driver"
	depends on I2C
	default n
	help
	  If you say yes here you will get support for
	  the MUIC device driver.

config USE_SAFEOUT
	bool "Using SAFEOUT device driver"
	depends on I2C
	default n
	help
	  If you say yes here you will get support for
	  the SAFEOUT device driver.

config MUIC_NOTIFIER
	bool "MUIC notifier support"
	depends on USE_MUIC
	default n
	help
	  If you say yes here you will get support for
	  the MUIC attached device status change notification.

config MUIC_ADCMODE_SWITCH_WA
	bool "Using MUIC chip ADC Mode change W/A"
	depends on USE_MUIC
	default n
	help
	  This feature is for MUIC chip's ADC Mode change
	  chip bug Workaround.

config MUIC_RUSTPROOF_ON_USER
	bool "Using MUIC chip Rustproof function ON for User binary"
	depends on USE_MUIC
	default n
	help
	  This feature is for MUIC chip's Rustproof function.

config UART3
        bool "UART3"
        default n
        help
          If you say yes, you can use xo shutdown

config MUIC_SUPPORT_CCIC
	bool "MUIC supports CCIC chip interface"
	depends on USE_MUIC
	default n
	help
	  If you say yes here you will get support for the CCIC chip.

config HICCUP_CHARGER
	bool "Using HICCUP charger"
	depends on USE_MUIC
	default n
	help
	 If you say yes here you will get support for
	 for the hiccup charger feature.

config MUIC_POGO
	bool "Using POGO MUIC"
	depends on USE_MUIC
	default y
	help
	  If you say yes here you will get support for
	  for the POGO
```

## drivers/samsung/Kconfig
```kconfig
# SPDX-License-Identifier: GPL-2.0-only

config DRV_SAMSUNG
	bool "Samsung sec class"
	help
	  Creates the "sec" device class (/sys/class/sec) used by Samsung
	  drivers to expose their factory and feature interfaces.
```
