// SPDX-License-Identifier: GPL-2.0-only
/* Samsung Galaxy Tab S5e Wi-Fi (SM-T720), board rev 09 */

/dts-v1/;
/plugin/;

#include <dt-bindings/interrupt-controller/arm-gic.h>
#include <dt-bindings/interrupt-controller/irq.h>
#include <dt-bindings/gpio/gpio.h>
#include <dt-bindings/clock/qcom,gcc-sdm845.h>
#include <dt-bindings/clock/qcom,camcc-sdm845.h>
#include <dt-bindings/clock/qcom,dispcc-sdm845.h>
#include <dt-bindings/clock/qcom,rpmh.h>
#include <dt-bindings/spmi/spmi.h>
#include <dt-bindings/thermal/thermal.h>
#include <dt-bindings/msm/msm-bus-ids.h>

#include "../qcom/sdm670-mtp.dtsi"
#include "sdm670-sec-common.dtsi"
#include "sdm670-sec-gts4lvwifi-common.dtsi"
#include "sdm670-sec-gts4lv-pm-common.dtsi"
#include "sdm670-sec-gts4lv-battery-common.dtsi"

#include "sdm670-sec-gts4lv-r09.dtsi"
#include "sdm670-sec-gts4lv-pinctrl-r09.dtsi"
#include "sdm670-sec-gts4lv-display-r09.dtsi"
#include "sdm670-sec-gts4lv-displayport-r05.dtsi"
#include "sdm670-sec-gts4lv-camera-sensor-r00.dtsi"

#include "sdm670-sec-gts4lv-overlay-common.dtsi"

/ {
	model = "Samsung GTS4LVWIFI PROJECT (board-id,09)";
	compatible = "qcom,sdm670-mtp", "qcom,sdm670", "qcom,mtp";
	qcom,board-id = <8 9>;
	qcom,pmic-id = <0x0001001b 0x0101011a 0x0 0x0>,
	               <0x0001001b 0x0102001a 0x0 0x0>,
	               <0x0001001b 0x0201011a 0x0 0x0>;
};
